## conf/layer.conf
```bitbake
# We have a conf and classes directory, add to BBPATH
BBPATH .= ":${LAYERDIR}"

# We have recipes-* directories, add to BBFILES
BBFILES += "${LAYERDIR}/recipes-*/*/*.bb \
	${LAYERDIR}/recipes-*/*/*.bbappend"

BBFILE_COLLECTIONS += "digi-maker"
BBFILE_PATTERN_digi-maker = "^${LAYERDIR}/"
BBFILE_PRIORITY_digi-maker = "6"

LAYERSERIES_COMPAT_digi-maker = "zeus"

LAYERDEPENDS_digi-maker = "digi-arm digi-dey raspberrypi"
```
